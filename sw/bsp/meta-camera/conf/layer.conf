## sw/bsp/meta-camera/conf/layer.conf
```bitbake
BBPATH .= ":${LAYERDIR}"

BBFILES += "${LAYERDIR}/recipes-*/*/*.bb \
            ${LAYERDIR}/recipes-*/*/*.bbappend"

BBFILE_COLLECTIONS += "meta-camera"
BBFILE_PATTERN_meta-camera = "^${LAYERDIR}/"
BBFILE_PRIORITY_meta-camera = "6"

LAYERDEPENDS_meta-camera = "core"
LAYERSERIES_COMPAT_meta-camera = "scarthgap"
```
